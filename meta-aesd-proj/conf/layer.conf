## meta-aesd-proj/conf/layer.conf
```bitbake
# We have a conf and classes directory, add to BBPATH
BBPATH .= ":${LAYERDIR}"

# We have recipes-* directories, add to BBFILES
BBFILES += "${LAYERDIR}/recipes-*/*/*.bb \
            ${LAYERDIR}/recipes-*/*/*.bbappend"

BBFILE_COLLECTIONS += "meta-aesd-proj"
BBFILE_PATTERN_meta-aesd-proj = "^${LAYERDIR}/"
BBFILE_PRIORITY_meta-aesd-proj = "6"

LAYERDEPENDS_meta-aesd-proj = "core"
LAYERSERIES_COMPAT_meta-aesd-proj = "mickledore"
```
